## sdkconfig.defaults
```kconfig
# =============================================================================
# ESP32-P4 Camera LCD Demo - SDK Configuration Defaults
# =============================================================================
# Target: Waveshare ESP32-P4-WiFi6-Touch-LCD-4B
# Display: 4" 720x720 ST7703 via MIPI DSI
# Touch: GT911 capacitive
# Camera: OV5647 via MIPI CSI

# -----------------------------------------------------------------------------
# Target Selection
# -----------------------------------------------------------------------------
CONFIG_IDF_TARGET="esp32p4"

# Enable experimental features (required for ESP32-P4)
CONFIG_IDF_EXPERIMENTAL_FEATURES=y

# -----------------------------------------------------------------------------
# Flash Configuration
# -----------------------------------------------------------------------------
CONFIG_ESPTOOLPY_FLASHMODE_QIO=y
CONFIG_ESPTOOLPY_FLASHSIZE_32MB=y

# -----------------------------------------------------------------------------
# Partition Table
# -----------------------------------------------------------------------------
CONFIG_PARTITION_TABLE_CUSTOM=y
CONFIG_PARTITION_TABLE_CUSTOM_FILENAME="partitions.csv"

# -----------------------------------------------------------------------------
# Compiler Configuration
# -----------------------------------------------------------------------------
CONFIG_COMPILER_OPTIMIZATION_PERF=y
CONFIG_APP_REPRODUCIBLE_BUILD=y

# -----------------------------------------------------------------------------
# PSRAM Configuration
# -----------------------------------------------------------------------------
CONFIG_SPIRAM=y
CONFIG_SPIRAM_SPEED_200M=y
CONFIG_SPIRAM_XIP_FROM_PSRAM=y

# -----------------------------------------------------------------------------
# Cache Configuration (ESP32-P4 specific)
# -----------------------------------------------------------------------------
CONFIG_CACHE_L2_CACHE_256KB=y
CONFIG_CACHE_L2_CACHE_LINE_128B=y

# -----------------------------------------------------------------------------
# Memory Configuration
# -----------------------------------------------------------------------------
CONFIG_ESP_MAIN_TASK_STACK_SIZE=10240

# -----------------------------------------------------------------------------
# FreeRTOS Configuration
# -----------------------------------------------------------------------------
CONFIG_FREERTOS_HZ=1000
CONFIG_FREERTOS_VTASKLIST_INCLUDE_COREID=y
CONFIG_FREERTOS_GENERATE_RUN_TIME_STATS=y

# -----------------------------------------------------------------------------
# SPI Flash Configuration
# -----------------------------------------------------------------------------
CONFIG_SPI_FLASH_SUPPORT_GD_CHIP=y

# -----------------------------------------------------------------------------
# Camera Configuration (OV5647 via MIPI CSI)
# -----------------------------------------------------------------------------
CONFIG_CAMERA_OV5647=y
CONFIG_CAMERA_OV5647_MIPI_RAW8_800X640_50FPS=y
CONFIG_ESP_VIDEO_ENABLE_ISP_PIPELINE_CONTROLLER=y

# -----------------------------------------------------------------------------
# LVGL Configuration (Version 9)
# -----------------------------------------------------------------------------
CONFIG_LV_USE_CLIB_MALLOC=y
CONFIG_LV_USE_CLIB_STRING=y
CONFIG_LV_USE_CLIB_SPRINTF=y
CONFIG_LV_DEF_REFR_PERIOD=15
CONFIG_LV_OS_FREERTOS=y
CONFIG_LV_DRAW_SW_DRAW_UNIT_CNT=2
CONFIG_LV_ATTRIBUTE_FAST_MEM_USE_IRAM=y
CONFIG_LV_FONT_MONTSERRAT_14=y
CONFIG_LV_FONT_MONTSERRAT_20=y
CONFIG_LV_FONT_MONTSERRAT_24=y
CONFIG_LV_FONT_MONTSERRAT_36=y
CONFIG_LV_USE_QRCODE=y
CONFIG_LV_BUILD_EXAMPLES=n
CONFIG_LV_BUILD_DEMOS=n

# -----------------------------------------------------------------------------
# Log Configuration
# -----------------------------------------------------------------------------
CONFIG_LOG_DEFAULT_LEVEL_INFO=y
```
